## drivers/dw1000/Kconfig
```kconfig
config DW1000
	bool "DW1000 device driver"
    default y
    depends on DT_HAS_QORVO_DW1000_ENABLED
    depends on SPI
	help
		Enable support for "qorvo,dw1000" radio driver.
```

## dts/bindings/qorvo,dw1000.yaml
```yaml
description: Qorvo DW1000 on SPI bus

compatible: "qorvo,dw1000"

include: [spi-device.yaml]

properties:
    reset-gpios:
      type: phandle-array
      required: true
      description: RESET pin

    int-gpios:
      type: phandle-array
      required: true
      description: IRQ pin

    wakeup-gpios:
      type: phandle-array
      required: false
      description: WAKEUP pin

    exton-gpios:
      type: phandle-array
      required: false
      description: EXTON pin
```
